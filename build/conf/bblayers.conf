## build/conf/bblayers.conf
```bitbake
# POKY_BBLAYERS_CONF_VERSION is increased each time build/conf/bblayers.conf
# changes incompatibly
POKY_BBLAYERS_CONF_VERSION = "2"

BBPATH = "${TOPDIR}"
BBFILES ?= ""

BBLAYERS ?= " \
    /media/naresh/ExtraDrive1/Projects/poky-dunfell/meta \
    /media/naresh/ExtraDrive1/Projects/poky-dunfell/meta-poky \
    /media/naresh/ExtraDrive1/Projects/poky-dunfell/meta-openembedded/meta-oe \
    /media/naresh/ExtraDrive1/Projects/poky-dunfell/meta-openembedded/meta-multimedia \
    /media/naresh/ExtraDrive1/Projects/poky-dunfell/meta-openembedded/meta-networking \
    /media/naresh/ExtraDrive1/Projects/poky-dunfell/meta-openembedded/meta-perl \
    /media/naresh/ExtraDrive1/Projects/poky-dunfell/meta-openembedded/meta-python \
    /media/naresh/ExtraDrive1/Projects/poky-dunfell/meta-qt5 \
    /media/naresh/ExtraDrive1/Projects/poky-dunfell/meta-raspberrypi \
    /media/naresh/ExtraDrive1/Projects/poky-dunfell/meta-security \
    /media/naresh/ExtraDrive1/Projects/poky-dunfell/meta-jumpnow \
    /media/naresh/ExtraDrive1/Projects/idk/meta-rpi \
    /media/naresh/ExtraDrive1/Projects/idk/meta-idk \
"
```

## meta-idk/conf/layer.conf
```bitbake
# We have a conf and classes directory, append to BBPATH
BBPATH .= ":${LAYERDIR}"

# We have a recipes directory, add to BBFILES
BBFILES += "${LAYERDIR}/recipes*/*/*.bb ${LAYERDIR}/recipes*/*/*.bbappend ${LAYERDIR}/images/*.bb"

BBFILE_COLLECTIONS += "meta-idk"
BBFILE_PATTERN_meta-idk := "^${LAYERDIR}/"
BBFILE_PRIORITY_meta-idk = "16"

LAYERSERIES_COMPAT_meta-idk = "dunfell"

packages_to_install = "hello runit opkg"

IMAGE_INSTALL_append = " ${packages_to_install}"
```
